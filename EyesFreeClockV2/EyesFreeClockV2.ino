/*            NoEye Haptic Clock V2.0           */
/*                                              */
/* Written by Michael Kafarowski 2019           */
/* michael.kafarowski.com                       */
/*                
*/

const PROGMEM uint16_t twelveData[2872] =
{
  2872, 0x807f, 0x7d7c, 0x797d, 0x7a78, 0x8080, 0x7d81, 0x8081,
0x827f, 0x847d, 0x8480, 0x8281, 0x8081, 0x7d7a, 0x7982, 0x7982,
0x817d, 0x817c, 0x817c, 0x817f, 0x8482, 0x8082, 0x8184, 0x7d82,
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0x807f, 0x807f, 0x807f, 0x807f, 0x807f, 0x807f, 0x807f, 0x807f
};

const PROGMEM uint16_t pmData[3160] =
{
  0x807f, 0x8080, 0x8080, 0x7f80, 0x7f80, 0x7f80, 0x7f7f, 0x807f,
0x8080, 0x7f80, 0x7f80, 0x7f7f, 0x807f, 0x8080, 0x7f80, 0x7f80,
0x807f, 0x807f, 0x807f, 0x8080, 0x7f80, 0x807f, 0x807f, 0x807f,
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0x807f, 0x807f, 0x807f, 0x807f, 0x807f, 0x807f, 0x807f, 0x807f
};

#define MODE_BUTTON 2     //aka button1
#define SET_BUTTON 3      //aka button2
#define IR_LED 5          //IR LED enable pin
#define IR_DETECT 6       //IR Detection Input
#define EEPROM_EN 10      //EEPROM Write Enable
#define HAPTIC_EN A2      //Haptic Driver Enable

#define DEBUG_LED 5       //IR LED, used for debugging for now

//Beep timings
#define BETWEENDELAY 800    //time to wait between tens and ones etc.
#define NONZEROBEEPTIME 50  //the time to beep for a non-zero number
#define ZEROBEEPTIME 300    //the time to beep for a zero
#define BEEPDELAY 200       //the spacing between beeps of the same group
#define GROUPDELAYADD 40    //the amount of delay between groupings (ie ... ... .. to make 8)

//Audio
#define SAMPLERATEMICROS 125     //8000Hz sample rate (period: 125uS)

//IR
#define IRTIMESHORT 500
#define IRTIMELONG 1500


#include <SPI.h>            //EEPROM chip
#include <Wire.h>           //
#include <MCP7940.h>        //RTC
#include "Adafruit_DRV2605.h" //Haptic Driver
#include <Adafruit_MCP4725.h> //DAC


//INPUT FLAGS
volatile bool buttonModeLast = false; //set to the previously recorded state of the buttons
volatile bool buttonSetLast = false;  //   so to avoid triggering every 20ms if held
volatile bool irSensorLast = false;   //set to the previously recorded state of the IR sensor
volatile bool buttonModeWait = false; //triggered from interrupt if main button is pressed
volatile bool buttonSetWait = false;  //triggered from interrupt if mode button is pressed
volatile bool checkInputWait = false; //triggered from interrupt if ready to check buttons
volatile bool checkIRWait = false;
volatile unsigned long irTimeMillis = 0;
volatile byte ioCheckCounter = 0;

//STATEs
bool timeSetMode = false;             //If set, the program will loop in time set mode
bool silentMode = false;              //If set, the device will vibrate rather than speak the time.
bool longWaveWait = false;            //If set, the device has picked up a hovering hand (trigger silent mode announcement)
bool shortWaveWait = false;           //If set, the device has picked up a wave (trigger audio announcement)

//AUDIO
bool audioPlaying = false;
uint16_t *audioTracks[2] = {twelveData, pmData};
int audioQueue[8] = {-1, -1, -1, -1, -1, -1, -1, -1};
uint16_t *audioData;                  //Currently loaded track to play
uint16_t audioSize;                   //Audio size is the first 16byte word in the audio data.
          

                   
unsigned long audioLastMicros = 0;
unsigned int audioFrameIndex = 0;

MCP7940_Class MCP7940;
Adafruit_DRV2605 drv;
Adafruit_MCP4725 dac;

byte rtcHour, rtcMinute, rtcSecond;

void setup(){
  //Set up Inputs
  pinMode(MODE_BUTTON, INPUT);
  pinMode(SET_BUTTON, INPUT);
  pinMode(IR_DETECT, INPUT);

  //Set up Outputs
  pinMode(IR_LED, OUTPUT);
  pinMode(EEPROM_EN, OUTPUT);
  pinMode(HAPTIC_EN, OUTPUT);

  //Set up RTC
  while (!MCP7940.begin()) {
    delay(100);
  }
  while(!MCP7940.deviceStatus()){
    bool deviceStatus = MCP7940.deviceStart();
    if(!deviceStatus){
      delay(100);
    }
  }
  MCP7940.adjust();
  MCP7940.setBattery(true);

  //Setup Haptic Driver
  drv.begin();
  drv.selectLibrary(1);
  drv.setMode(DRV2605_MODE_INTTRIG);

  //Setup Audio DAC
  dac.begin(0x60);

  //Set up button poll timer interrupts.
  cli();
  
  TCCR1A = 0;
  TCCR1B = 0;
  TCNT1  = 0;

  OCR1A = 2400;
  TCCR1B |= (1 << WGM12); //CTC
  TCCR1B |= (1 << CS12); //256 Prescaler
  TIMSK1 |= (1 << OCIE1A); //Timer interupt enable

  sei();

  digitalWrite(IR_LED, HIGH); //TEMP
  delay(100);
  digitalWrite(IR_LED, LOW); //TEMP
  delay(100);
  digitalWrite(IR_LED, HIGH); //TEMP
  delay(100);
  digitalWrite(IR_LED, LOW); //TEMP
}

void loop() {
  //Button Processing
    if(checkInputWait){
    checkInput();
    if(buttonModeWait || shortWaveWait || longWaveWait){
      announceTime(silentMode);
      clearInputRequest();
    } else if (buttonSetWait){
      timeSetMode = true;
      setTimeMode();
      clearInputRequest();
    }
  }

  //Audio Processing
    if(audioPlaying){
      processAudioFrame();
    }
}
